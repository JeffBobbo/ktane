/*************************************************** 
  Backpack library for 4 digit 14 segment display
  Adapted from Adafruit's library to run with SoftWire 
 ****************************************************/
#include "AlphaNum4.h"


#ifndef _BV
  #define _BV(bit) (1<<(bit))
#endif

#ifndef _swap_int16_t
#define _swap_int16_t(a, b) { int16_t t = a; a = b; b = t; }
#endif

static const uint16_t alphafonttable[] PROGMEM = {
  0b0000000000000001,
  0b0000000000000010,
  0b0000000000000100,
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  0b0011111111111111,
};

AlphaNum4::AlphaNum4(const uint8_t sda, const uint8_t scl) : pin_sda(sda), pin_scl(scl), sw(pin_sda, pin_scl)
{
}

void AlphaNum4::begin(const uint8_t _addr = 0x70)
{
  i2c_addr = _addr;

  sw.setRxBuffer(rxbuf, 32);
  sw.setTxBuffer(txbuf, 32);
  sw.setTimeout_ms(200);
  sw.begin();

  sw.beginTransmission(i2c_addr);
  sw.write(0x21);  // turn on oscillator
  sw.endTransmission();
  this->blinkRate(HT16K33_BLINK_OFF);
  
  this->setBrightness(15); // max brightness
}

void AlphaNum4::setBrightness(uint8_t b)
{
  if (b > 15)
    b = 15;
  sw.beginTransmission(i2c_addr);
  sw.write(HT16K33_CMD_BRIGHTNESS | b);
  sw.endTransmission();  
}

void AlphaNum4::blinkRate(uint8_t b) {
  sw.beginTransmission(i2c_addr);
  if (b > 3) // turn off if not sure
    b = 0;

  sw.write(HT16K33_BLINK_CMD | HT16K33_BLINK_DISPLAYON | (b << 1)); 
  sw.endTransmission();
}

void AlphaNum4::writeDisplay() {
  sw.beginTransmission(i2c_addr);
  sw.write((uint8_t)0x00); // start at address $00

  for (size_t i = 0; i < 8; ++i)
  {
    sw.write(displaybuffer[i] & 0xFF);    
    sw.write(displaybuffer[i] >> 8);    
  }
  sw.endTransmission();  
}

void AlphaNum4::clear()
{
  for (size_t i = 0; i < 8; ++i)
    displaybuffer[i] = 0;
}

void AlphaNum4::writeDigitRaw(uint8_t n, uint16_t bitmask)
{
  displaybuffer[n] = bitmask;
}

void AlphaNum4::writeDigitAscii(uint8_t n, uint8_t a, bool d) {
  uint16_t font = pgm_read_word(alphafonttable + a);

  displaybuffer[n] = font;

  if (d)
    displaybuffer[n] |= (1<<14);
}

